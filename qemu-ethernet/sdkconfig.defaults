## rust/http-server/sdkconfig.defaults
```kconfig
# Rust often needs a bit of an extra main task stack size compared to C
# (the default is 3K)
CONFIG_ESP_MAIN_TASK_STACK_SIZE=8000

# qemu only supports openeth
CONFIG_ETH_USE_SPI_ETHERNET=n
CONFIG_ETH_USE_OPENETH=y
```
